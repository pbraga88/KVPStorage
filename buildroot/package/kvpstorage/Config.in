## buildroot/package/kvpstorage/Config.in
```kconfig
config BR2_PACKAGE_KVPSTORAGE
    bool "kvpstorage"
    select BR2_PACKAGE_LIBSODIUM
    help
      Encrypted key-value storage application (kvpstorage)
```
